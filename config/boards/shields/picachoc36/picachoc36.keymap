// Copyright (c) 2022 The ZMK Contributors
// SPDX-License-Identifier: MIT

#include <behaviors.dtsi>
#include <dt-bindings/zmk/keys.h>

#include "../../../include/behaviors.dtsi"
#include "../../../include/layers.dtsi"

/ {
    keymap {
        compatible = "zmk,keymap";
    };

    combos {
        compatible = "zmk,combos";
    };
};
