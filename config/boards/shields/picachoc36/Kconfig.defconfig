## config/boards/shields/picachoc36/Kconfig.defconfig
```kconfig
if SHIELD_PICACHOC36_LEFT

config ZMK_KEYBOARD_NAME
	default "Picachoc 36"

config ZMK_SPLIT_ROLE_CENTRAL
	default y

endif

if SHIELD_PICACHOC36_LEFT || SHIELD_PICACHOC36_RIGHT

config ZMK_SPLIT
	default y

endif
```

## config/boards/shields/picachoc36/Kconfig.shield
```kconfig
config SHIELD_PICACHOC36_LEFT
	def_bool $(shields_list_contains,picachoc36_left)

config SHIELD_PICACHOC36_RIGHT
	def_bool $(shields_list_contains,picachoc36_right)
```

## config/west.yml
```yaml
manifest:
  remotes:
    - name: zmkfirmware
      url-base: https://github.com/Katona
  projects:
    - name: zmk
      remote: zmkfirmware
      revision: split_battery_service
      import: app/west.yml
  self:
    path: config
```
